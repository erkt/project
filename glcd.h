#define GLCD P0  // 8 data lines

#define PAGE_0 0xb8  // first page address
#define PAGE_7 0xbf  // last  page address
#define COL_ADDR 0x40 //base address of 64 columns

#define NONE 0
#define C1   1
#define C2   2
#define BOTH 3
	
void InitGLCD(void);
void CmdGLCD(unsigned char,unsigned char);
void DispGLCD(unsigned char);
void WriteGLCD(unsigned char);
void ChipSel(unsigned char);
void ClrScreen();
void ClrPage(unsigned char,unsigned char );

void ShowDigit(unsigned char);
void ShowImage(void);
code unsigned char char_c_arr[][5]={/*A*/0xfe,0x11,0x11,0x11,0xfe,/*B*/0xff,0x91,0x91,0x91,0x6e,/*C*/0x7e,0x81,0x81,0x81,0x42,/*D*/0xff,0x81,0x81,0x81,0x7e,/*E*/0xff,0x91,0x91,0x91,0x81,   
								  /*F*/0xff,0x09,0x09,0x01,0x01,/*G*/0x7e,0x81,0x81,0x91,0x73,/*H*/0xff,0x10,0x10,0x10,0xff,/*I*/0x00,0x81,0xff,0x81,0x00,/*J*/0x60,0x80,0x80,0x81,0x7f,
								  /*K*/0xff,0x18,0x3c,0x66,0xc3,/*L*/0xff,0x80,0x80,0x80,0xc0,/*M*/0xff,0x06,0x08,0x06,0xff,/*N*/0xff,0x06,0x18,0x60,0xff,/*O*/0x7e,0x81,0x81,0x81,0x7e,    
								  /*P*/0xff,0x09,0x09,0x09,0x06,/*Q*/0x3e,0x41,0xc1,0xc1,0x3e,/*R*/0xff,0x11,0x31,0x51,0x8e,/*S*/0xce,0x91,0x91,0x91,0x63,/*T*/0x03,0x01,0xff,0x01,0x03,
								  /*U*/0x7f,0x80,0x80,0x80,0x7f,/*V*/0x07,0x38,0xc0,0x38,0x07,/*W*/0x7e,0x80,0x70,0x80,0x7e,/*X*/0xc3,0x66,0x18,0x66,0xc3,/*Y*/0x03,0x0c,0xf0,0x0c,0x03,
								  /*Z*/0x81,0xe1,0x99,0x87,0x81};
code unsigned char char_s_arr[][5]={/*a*/        /*b*/0xff,0x91,0x91,0x91,0x6e,/*c*/0x7e,0x81,0x81,0x81,0x42,/*d*/0xff,0x81,0x81,0x81,0x7e,/*e*/0xff,0x91,0x91,0x91,0x81,   
								  /*f*/0xff,0x09,0x09,0x01,0x01,/*g*/0x7e,0x81,0x81,0x91,0x73,/*h*/0xff,0x10,0x10,0x10,0xff,/*i*/0x00,0x81,0xff,0x81,0x00,/*j*/0x60,0x80,0x80,0x81,0x7f,
								  /*k*/0xff,0x18,0x3c,0x66,0xc3,/*l*/0xff,0x80,0x80,0x80,0xc0,/*m*/0xff,0x06,0x08,0x06,0xff,/*n*/0xff,0x06,0x18,0x60,0xff,/*o*/0x7e,0x81,0x81,0x81,0x7e,    
								  /*p*/0xff,0x09,0x09,0x09,0x06,/*q*/0x3e,0x41,0xc1,0xc1,0x3e,/*r*/0xff,0x11,0x31,0x51,0x8e,/*s*/0xce,0x91,0x91,0x91,0x63,/*t*/0x03,0x01,0xff,0x01,0x03,
								  /*u*/0x7f,0x80,0x80,0x80,0x7f,/*v*/0x07,0x38,0xc0,0x38,0x07,/*w*/0x7e,0x80,0x70,0x80,0x7e,/*x*/0xc3,0x66,0x18,0x66,0xc3,/*y*/0x03,0x0c,0xf0,0x0c,0x03,
								  /*z*/0x81,0xe1,0x99,0x87,0x81};
code unsigned char space[5]={0x00,0x00,0x00,0x00,0x00};
code unsigned char colon[5]={0x00,0x00,0x24,0x00,0x00};
code unsigned char digit_arr[10][5]={
							/*0*/	 0xff,0x81,0x81,0xff,0x00,
							/*1*/    0x00,0x00,0xff,0x00,0x00,
							/*2*/	 0xf9,0x89,0x89,0x8f,0x00,
							/*3*/	 0x89,0x89,0x89,0xff,0x00,
							/*4*/	 0x0f,0x08,0x08,0xff,0x00,
							/*5*/    0x8f,0x89,0x89,0xf9,0x00,
							/*6*/    0xff,0x89,0x89,0xf9,0x00,
							/*7*/    0x01,0x01,0x01,0xff,0x00,
							/*8*/    0xff,0x89,0x89,0xff,0x00,
							/*9*/    0x9f,0x91,0x91,0xff,0x00

									};
void ShowDigit(unsigned char);

void InitGLCD(void)
{
    RST = 0;
    RST = 1;
    CmdGLCD(0x3e,1);// 0x3E turn it Off. 
    CmdGLCD(0x3f,1);// 0x3F Display ON.     
    CmdGLCD(0xb8,1);// page 0 base address
    CmdGLCD(0x40,1);// col base address
    CmdGLCD(0xc0,1);//taking cursor to top line of refresh ram
}

void CmdGLCD(unsigned char cmd,unsigned char chip)
{
    ChipSel(chip);
    RS = 0;
    WriteGLCD(cmd);
}	

void DispGLCD(unsigned char ch)
{
    RS = 1;
	WriteGLCD(ch);
}

void WriteGLCD(unsigned char val)
{
	RW = 0;
    GLCD = val;
    EN = 1;
    EN = 0;
}

void ChipSel(unsigned char cs)
{
   switch(cs)
   {
     case 0: CS1=0; CS2=0;return;
     case 1: CS1=1; CS2=0;return;
     case 2: CS1=0; CS2=1;return;
     case 3: CS1=1; CS2=1;return;
   }  
} 
 
void ClrScreen()
{
   int i,y;
   for(i=PAGE_0;i<=PAGE_7;i++)          
   {
     CmdGLCD(i,BOTH);      // Select Pages.  
     CmdGLCD(COL_ADDR,BOTH);                      
     for(y=0;y<64;y++)
        DispGLCD(0x00); // Clear data in the LCD.
   }    
}

void ClrPage(unsigned char page,unsigned char chip)
{
  unsigned char y;
  CmdGLCD(PAGE_0+page,chip);  	    	
  CmdGLCD(COL_ADDR,chip);
  for (y=0;y<64;y++)
       DispGLCD(0x00); // Clear data in the LCD.
}

void ShowDigit(unsigned char dig)
{
   unsigned char i;
   for(i=0;i<4;i++)
   {
     DispGLCD(digit_arr[dig][i]);
   } 
   DispGLCD(0x00);    
}
void Co(){
	char j;
	for(j=0;j<5;j++)
		DispGLCD(colon[j]);
}
void ShowString(char *p){
		char i,j;
		for(i=0;p[i];i++){
			for(j=0;j<5;j++){
				if('A' <= p[i] && p[i] <= 'Z') 				 
					DispGLCD(char_c_arr[p[i]-65][j]);
				else if('a' <= p[i] && p[i] <= 'z')
					DispGLCD(char_s_arr[p[i]-97][j]);
				else if('0' <= p[i] && p[i] <='9')
					DispGLCD(digit_arr[p[i]-48][j]);
				else if(' '==p[i])
					DispGLCD(space[j]);
			}
		}
}
